## components/board_hal/Kconfig
```kconfig
menu "Board Configuration"

    choice BOARD_TYPE
        prompt "Board Driver"
        default BOARD_DRIVER_WAVESHARE_PHOTOPAINTER_73
        help
            Select the power management driver to use.

        config BOARD_DRIVER_READ_PICO
            bool "Read Pico (controlled bring-up)"
            depends on IDF_TARGET_ESP32S3
            help
                Default entry: I2C identity/status/VCOM queries, no screen power.
                Explicit display-validation profile enables command-armed white/GC16 tests.
                Neither entry enables SD, NVS, network or PMU calibration writes.
                80 MHz compile timing is NOT the product display profile.

        config BOARD_DRIVER_WAVESHARE_PHOTOPAINTER_73
            bool "WaveShare PhotoPainter 7.3in"
            select PMIC_DRIVER_AXP2101
            select SDCARD_DRIVER_SDIO
            select SENSOR_DRIVER_SHTC3
            select RTC_DRIVER_PCF85063
            select EP_DRIVER_ED2208_GCA
            help
                Driver for WaveShare PhotoPainter 7.3in (Spectra 6) board.
                Includes AXP2101 PMIC initialization and SHTC3 sensor sleep management.
                SD card: SDIO interface (4-bit mode).

        config BOARD_DRIVER_SEEEDSTUDIO_XIAO_EE02
            bool "Seeed XIAO EE02 (BQ24070)"
            select EP_DRIVER_ED2208_NCA
            help
                Driver for Seeed Studio XIAO EE02 board.
                Uses BQ24070 Linear Charger.
                Voltage is read via ADC. Percentage is estimated.
                Charging status via GPIO.
                No SD card support.
                AI rotation mode disabled due to limited PSRAM.

        config BOARD_DRIVER_SEEEDSTUDIO_XIAO_EE04
            bool "Seeed XIAO EE04 (7.3in Spectra 6)"
            select EP_DRIVER_ED2208_GCA
            help
                Driver for Seeed Studio XIAO EE04 board (7.3" 6-color).
                Uses BQ24070 Linear Charger.
                Voltage is read via ADC. Percentage is estimated.
                Charging status via GPIO.
                No SD card support.
                AI rotation mode disabled due to limited PSRAM.

        config BOARD_DRIVER_SEEEDSTUDIO_XIAO_EE03
            bool "Seeed XIAO EE03 (10.3\" Grayscale GC16)"
            select EP_DRIVER_IT8951
            select SENSOR_DRIVER_SHT40
            help
                Driver for the Seeed Studio XIAO ePaper Display Board EE03: a
                XIAO ESP32-S3 Plus driving a 10.3" grayscale panel (1872x1404,
                16-level / GC16) via an IT8951 T-CON over SPI. Same panel as the
                reTerminal E1003, on the XIAO ePaper driver-board wiring.
                Includes an SHT40 sensor for waveform temperature compensation
                and battery monitoring via ADC. No SD card, no external RTC.

        config BOARD_DRIVER_SEEEDSTUDIO_RETERMINAL_E1002
            bool "Seeed reTerminal E1002 (Spectra E6)"
            select SDCARD_DRIVER_SPI
            select SENSOR_DRIVER_SHT40
            select RTC_DRIVER_PCF8563
            select EP_DRIVER_ED2208_GCA
            help
                Driver for Seeed reTerminal E1002 with 7.3" Spectra E6 display.
                Includes battery monitoring and deep sleep support.
                SD card: SPI interface.

        config BOARD_DRIVER_SEEEDSTUDIO_RETERMINAL_E1003
            bool "Seeed reTerminal E1003 (10.3\" Grayscale GC16)"
            select SDCARD_DRIVER_SPI
            select SENSOR_DRIVER_SHT40
            select RTC_DRIVER_PCF8563
            select EP_DRIVER_IT8951
            help
                Driver for Seeed reTerminal E1003 with 10.3" grayscale display
                (1872x1404, 16-level / GC16) driven by an IT8951 T-CON over SPI.
                Includes SY6974B charger, battery monitoring, and deep sleep.
                SD card: SPI interface (shared bus with the IT8951).

        config BOARD_DRIVER_SEEEDSTUDIO_RETERMINAL_E1004
            bool "Seeed reTerminal E1004 (13.3\" Spectra 6)"
            select SDCARD_DRIVER_SPI
            select SENSOR_DRIVER_SHT40
            select RTC_DRIVER_PCF8563
            select EP_DRIVER_ED2208_NCA
            help
                Driver for Seeed reTerminal E1004 with 13.3" Spectra 6 display
                (1200x1600, dual-CS ED2208-NCA panel).
                Includes battery monitoring and deep sleep support.
                The panel rail is gated by a software-controlled load switch.
                SD card: SPI interface.

        config BOARD_DRIVER_M5STACK_M5PAPER_V11
            bool "M5Stack M5Paper v1.1 (4.7\" Grayscale GC16)"
            select SDCARD_DRIVER_SPI
            select SENSOR_DRIVER_SHT3X
            select RTC_DRIVER_PCF8563
            select EP_DRIVER_IT8951
            help
                Driver for the M5Stack M5Paper v1.1: an ESP32-D0WDQ6-V3 (not an
                S3) with 8MB PSRAM driving a 4.7" grayscale panel (960x540,
                16-level / GC16) via an IT8951 T-CON over SPI. Includes an SHT30
                sensor for waveform temperature compensation, a BM8563 RTC
                (PCF8563-compatible), battery monitoring via ADC, and a microSD
                slot on the same SPI bus as the IT8951.
                v1.0 is electrically identical and works with this driver too.

    endchoice

    config READ_PICO_DISPLAY_VALIDATION
        bool "Read Pico controlled display validation (explicit hardware authorization required)"
        depends on BOARD_DRIVER_READ_PICO && !READ_PICO_PHOTO_VALIDATION
        default n
        help
            Factory-layout, command-armed display validation, not a product application.
            Screen power starts only on clear-white. White reference requires a separate
            human white-confirm command. Each GC16 pattern needs explicit draw and
            visual confirmation; failures prohibit more draws. No automatic cycling.
            No SD/NVS/network/PMU calibration writes.

    config READ_PICO_STORAGE_VALIDATION
        bool "Read Pico controlled SD validation (explicit hardware authorization required)"
        depends on BOARD_DRIVER_READ_PICO && !READ_PICO_DISPLAY_VALIDATION && !READ_PICO_PHOTO_VALIDATION
        select SDCARD_DRIVER_SDIO
        default n
        help
            Isolated command-armed SD entry, not a product application.
            Startup only reads board/CD state; mount explicitly requests a single
            PhotoFrame SDMMC attempt at /storage. Explicit file-test exclusively
            creates RC3T0001.BIN once, writes/syncs/closes/reopens/verifies 4096
            bytes and retains it; no overwrite/delete or automatic file IO.
            Explicit file-check only reads/verifies this existing fixed file once,
            never creating, writing or repairing it. Requires a valid mounted card.
            No format, display, NVS, network or PMU power/calibration writes.
            Close errors block unmount/HAL teardown until restart.

    config READ_PICO_PHOTOFRAME_INTEGRATION
        bool "Read Pico full PhotoFrame integration build (runtime disabled)"
        depends on BOARD_DRIVER_READ_PICO && !READ_PICO_DISPLAY_VALIDATION && !READ_PICO_STORAGE_VALIDATION && !READ_PICO_PHOTO_VALIDATION
        select SDCARD_DRIVER_SDIO
        default n
        help
            Compile/link the real PhotoFrame business stack for Read Pico.
            Boot entry refuses product startup pending hardware/data migration
            and physical white-reference acceptance. Never a release/flash profile.

    config READ_PICO_LOCAL_FRAME
        bool "Read Pico R1 local Web/SD frame candidate"
        depends on READ_PICO_PHOTOFRAME_INTEGRATION
        default n
        help
            Identifies the isolated local upload/display/rotation candidate.
            Uses the existing factory layout; no automatic flash or migration.
            Starts the local product with an automatic boot clear. Requires
            separate hardware deployment approval; not a diagnostic profile.

    config READ_PICO_PHOTO_VALIDATION
        bool "Read Pico single-photo diagnostic (explicit hardware authorization required)"
        depends on BOARD_DRIVER_READ_PICO
        select SDCARD_DRIVER_SDIO
        default n
        help
            Isolated fixed RC3P0001.JPG read-only photo display diagnostic.
            No boot mount/display, NVS or network; explicit one mount, one clear,
            human white-confirm, one photo-show and human photo-confirm/reject.
            Uses the real JPEG/EXIF/Cover/dither code with RAM-only settings.
            Stop frees display, unmounts SD, then releases HAL; failure is terminal.

    config USE_INTERNAL_FLASH_STORAGE
        bool "Use internal flash as storage (LittleFS)"
        default y if BOARD_DRIVER_SEEEDSTUDIO_XIAO_EE02 || BOARD_DRIVER_SEEEDSTUDIO_XIAO_EE03 || BOARD_DRIVER_SEEEDSTUDIO_XIAO_EE04 || BOARD_DRIVER_SEEEDSTUDIO_RETERMINAL_E1002 || BOARD_DRIVER_SEEEDSTUDIO_RETERMINAL_E1004
        default n
        help
            Mounts a LittleFS partition from internal flash to use as storage.
            Disable this if your board has limited flash space (e.g. 4MB)
            and you don't have enough space for a storage partition.
            If disabled, the system will use a small RAM-based filesystem (MemFS)
            for temporary image processing instead.

endmenu
```

## components/sdcard/Kconfig
```kconfig
config HAS_SDCARD
    bool
    default n
    help
        Automatically enabled when an SD card driver is selected.
        This flag is used to conditionally compile SD card-related code.

config SDCARD_DRIVER_SDIO
    bool "SDMMC SD Card Driver"
    select HAS_SDCARD
    help
        Use the native SDMMC host in board-selected 1-bit or 4-bit mode.
        The board configuration must provide the bus width and required pins.

        This is automatically selected by board drivers that use SDIO.

config SDCARD_DRIVER_SPI
    bool "SPI SD Card Driver"
    select HAS_SDCARD
    help
        Use SPI interface for SD card.
        More flexible pin assignment but slower than SDIO.

        This is automatically selected by board drivers that use SPI.
```
